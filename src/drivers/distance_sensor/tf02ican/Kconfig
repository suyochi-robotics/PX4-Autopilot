## src/drivers/distance_sensor/tf02ican/Kconfig
```kconfig
menuconfig DRIVERS_DISTANCE_SENSOR_TF02ICAN
    bool "tf02i_can"
    default n
    ---help---
        Enable support for Benewake TF02-i CAN distance sensor
```

## src/drivers/flow_sensor/Kconfig
```kconfig
menuconfig DRIVERS_FLOW_SENSOR
	bool "flow_sensor"
	default n
	---help---
		Enable support for flow sensor
```

## src/modules/obstacle_manager/Kconfig
```kconfig
menuconfig MODULES_OBSTACLE_MANAGER
	bool "obstacle_manager"
	default n
	---help---
		Enable support for obstacle_manager
```

## src/modules/sensors/bw_obstacle_avoidance/Kconfig
```kconfig
menuconfig SENSORS_BW_OBSTACLE_AVOIDANCE
    bool "backward obstcle avoidance"
    default y
    ---help---
      Enables the bw_obstcle_avoidance module for backward obstacle avoidance.
```

## src/modules/sensors/fw_obstacle_avoidance/Kconfig
```kconfig
menuconfig SENSORS_FW_OBSTACLE_AVOIDANCE
    bool "Forward obstacle avoidance"
    default y
    ---help---
      Enables the fw_avoidance_avoidance module for front obstacle avoidance.
```

## src/modules/sensors/terrain_following/Kconfig
```kconfig
menuconfig SENSORS_TERRAIN_FOLLOWING
    bool "Terrain following"
    default y
    ---help---
      Enables the terrain_following module for terrain following.
```
